/*
 * =================================================================================
 * FIRMWARE FOR ROCKFALL PREDICTION SENSOR NODE
 * =================================================================================
 * Board: ESP32 Dev Module
 * Language: Arduino C++
 * Purpose: To read a sensor, connect to WiFi, and publish data to a unique
 * MQTT topic for ingestion by the backend server.
 *
 * --- PREREQUISITES ---
 * 1. Install the Arduino IDE and configure it for the ESP32 board.
 * 2. In the Arduino Library Manager, install the following libraries:
 * - "PubSubClient" by Nick O'Leary
 * - "ArduinoJson" by Benoit Blanchon
 * =================================================================================
 */

#include <WiFi.h>
#include <PubSubClient.h>
#include <ArduinoJson.h>

// =================================================================================
// --- 1. CONFIGURATION (FILL THIS OUT) ---
// =================================================================================

// WiFi Network Credentials
const char* WIFI_SSID = "YOUR_MINE_WIFI_SSID";
const char* WIFI_PASSWORD = "YOUR_MINE_WIFI_PASSWORD";

// MQTT Broker Configuration
const char* MQTT_BROKER = "your_mqtt_broker_address"; // e.g., "192.168.1.100" or a cloud address
const int MQTT_PORT = 1883;

/*
 * !! CRITICAL !!
 * This MQTT topic MUST be the one generated by your backend API when you
 * registered this specific sensor. It uniquely identifies this device.
 * Example: "mines/mine-uuid-1234/zones/zone-uuid-5678/sensors/sg-alpha-c4-001/data"
 */
const char* MQTT_TOPIC = "PASTE_UNIQUE_MQTT_TOPIC_FROM_YOUR_API_HERE";

// A unique ID for this client. Can be anything, but often the device's MAC address.
const char* MQTT_CLIENT_ID = "esp32-strain-sensor-01";


// =================================================================================
// --- 2. GLOBAL VARIABLES & OBJECTS ---
// =================================================================================

WiFiClient espClient;
PubSubClient mqttClient(espClient);

// Timing variables for non-blocking delay
unsigned long lastMsgTime = 0;
const int MSG_INTERVAL_MS = 10000; // Send data every 10 seconds

// =================================================================================
// --- 3. SENSOR SIMULATION (Replace with your actual sensor code) ---
// =================================================================================

// This function simulates reading a strain gauge.
// In a real application, you would read from an analog pin:
// float voltage = analogRead(SENSOR_PIN) * (3.3 / 4095.0);
float readStrainSensor() {
  // Generate a realistic but random strain value for demonstration
  float baseline_strain = 0.015;
  float noise = (float)random(-100, 100) / 50000.0; // small random fluctuation
  return baseline_strain + noise;
}

// =================================================================================
// --- 4. SETUP & CONNECTION LOGIC ---
// =================================================================================

void setup_wifi() {
  delay(10);
  Serial.println();
  Serial.print("Connecting to WiFi: ");
  Serial.println(WIFI_SSID);

  WiFi.begin(WIFI_SSID, WIFI_PASSWORD);

  while (WiFi.status() != WL_CONNECTED) {
    delay(500);
    Serial.print(".");
  }

  Serial.println("");
  Serial.println("WiFi connected!");
  Serial.print("IP address: ");
  Serial.println(WiFi.localIP());
}

void reconnect_mqtt() {
  // Loop until we're reconnected
  while (!mqttClient.connected()) {
    Serial.print("Attempting MQTT connection...");
    // Attempt to connect
    if (mqttClient.connect(MQTT_CLIENT_ID)) {
      Serial.println("connected!");
    } else {
      Serial.print("failed, rc=");
      Serial.print(mqttClient.state());
      Serial.println(" try again in 5 seconds");
      // Wait 5 seconds before retrying
      delay(5000);
    }
  }
}

void setup() {
  Serial.begin(115200);
  setup_wifi();
  mqttClient.setServer(MQTT_BROKER, MQTT_PORT);
}


// =================================================================================
// --- 5. MAIN PROGRAM LOOP ---
// =================================================================================

void loop() {
  if (!mqttClient.connected()) {
    reconnect_mqtt();
  }
  mqttClient.loop();

  unsigned long now = millis();
  if (now - lastMsgTime > MSG_INTERVAL_MS) {
    lastMsgTime = now;

    // 1. Read the sensor value
    float strainValue = readStrainSensor();
    Serial.print("Sensor Reading (Strain): ");
    Serial.println(strainValue);

    // 2. Create the JSON payload using ArduinoJson
    StaticJsonDocument<200> doc;
    doc["sensor_id"] = MQTT_CLIENT_ID; // Can also send the full topic for verification
    doc["value"] = strainValue;
    doc["timestamp"] = millis(); // A simple timestamp; a real-time clock (RTC) module is better

    // 3. Serialize the JSON document to a string
    char jsonBuffer[512];
    serializeJson(doc, jsonBuffer);

    // 4. Publish the message to the MQTT topic
    mqttClient.publish(MQTT_TOPIC, jsonBuffer);
    Serial.print("Published message to topic: ");
    Serial.println(MQTT_TOPIC);
    Serial.print("Message: ");
    Serial.println(jsonBuffer);
    Serial.println("--------------------------------");
  }
}
